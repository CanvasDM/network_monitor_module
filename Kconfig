## Kconfig
```kconfig
#
# Copyright (c) 2022 Laird Connectivity LLC
#
# SPDX-License-Identifier: LicenseRef-LairdConnectivity-Clause
#
menuconfig LCZ_NETWORK_MONITOR
    bool "LC Network Monitor"
    depends on NETWORKING
    depends on NET_MGMT
    depends on NET_MGMT_EVENT

if LCZ_NETWORK_MONITOR

config LCZ_NETWORK_MONITOR_INIT_PRIORITY
    int "Init priority Application for network monitor module"
    range 0 99
    default 0
    help
      Recommended to be higher than main thread init priority.

module=LCZ_NETWORK_MONITOR
module-dep=LOG
module-str=Log level
source "${ZEPHYR_BASE}/subsys/logging/Kconfig.template.log_config"

endif # LCZ_NETWORK_MONITOR
```

## tests/network_ready/testcase.yaml
```yaml
sample:
  description: Monitor network interface events
  name: LCZ NM
common:
    tags: lcz_network_monitor
    platform_allow: pinnacle_100_dvk mg100 bl5340_dvk_cpuapp
    harness: console
    harness_config:
      type: multi_line
      regex:
        - "Network interface is ready!"
tests:
  lcz.network_monitor.network_ready:
    tags: lcz_network_monitor
  lcz.network_monitor.network_ready.dns:
    extra_args: OVERLAY_CONFIG=prj.dns_overlay.conf
    tags: lcz_network_monitor
```
