## CMakeLists.txt
```
#
# Copyright (c) 2022 Laird Connectivity
#
# SPDX-License-Identifier: LicenseRef-LairdConnectivity-Clause
#

cmake_minimum_required(VERSION 3.20.0)

find_package(Zephyr REQUIRED HINTS $ENV{ZEPHYR_BASE})

project(lcz_network_monitor)

target_sources(app PRIVATE src/main.c)
```

## prj.conf
```kconfig
#
# Copyright (c) 2022 Laird Connectivity
#
# SPDX-License-Identifier: LicenseRef-LairdConnectivity-Clause
#
CONFIG_LOG=y
CONFIG_LOG2_MODE_DEFERRED=y
CONFIG_LCZ_NETWORK_MONITOR=y
CONFIG_LCZ_NETWORK_MONITOR_LOG_LEVEL_DBG=y
CONFIG_NETWORKING=y
CONFIG_NET_MGMT=y
CONFIG_NET_MGMT_EVENT=y
CONFIG_NET_IPV4=y
CONFIG_NET_IPV6=y

# These features are not required for tests, but are nice for manual testing
CONFIG_SHELL=y
CONFIG_NET_SHELL=y
```

## boards/bl5340_dvk_cpuapp.conf
```kconfig
#
# Copyright (c) 2022 Laird Connectivity
#
# SPDX-License-Identifier: LicenseRef-LairdConnectivity-Clause
#

CONFIG_SPI=y
CONFIG_NET_L2_ETHERNET=y
CONFIG_ETH_ENC424J600=y
CONFIG_NET_DHCPV4=y
```

## boards/pinnacle_100_dvk.conf
```kconfig
#
# Copyright (c) 2022 Laird Connectivity
#
# SPDX-License-Identifier: LicenseRef-LairdConnectivity-Clause
#

CONFIG_MODEM=y
CONFIG_MODEM_HL7800_CONFIGURE_BANDS=n
```

## src/main.c
```c
/*
 * Copyright (c) 2022 Laird Connectivity LLC
 *
 * SPDX-License-Identifier: LicenseRef-LairdConnectivity-Clause
 */

/**************************************************************************************************/
/* Includes                                                                                       */
/**************************************************************************************************/

#include <logging/log.h>
LOG_MODULE_REGISTER(main, LOG_LEVEL_DBG);

#include <zephyr.h>

#include "lcz_network_monitor.h"

/**************************************************************************************************/
/* Local Constant, Macro and Type Definitions                                                     */
/**************************************************************************************************/

static struct lcz_nm_event_agent event_agent;

/**************************************************************************************************/
/* Local Function Definitions                                                                     */
/**************************************************************************************************/

static void nm_event_callback(enum lcz_nm_event event)
{
	LOG_INF("Event %d", event);
}

/**************************************************************************************************/
/* Global Function Definitions                                                                    */
/**************************************************************************************************/

void main(void)
{
	LOG_INF("Network Monitor Test");

	event_agent.callback = nm_event_callback;
	lcz_nm_register_event_callback(&event_agent);

	while (!lcz_nm_network_ready()) {
		k_sleep(K_MSEC(250));
	}

	LOG_INF("Network interface is ready!");
}
```
